## conf/layer.conf
```bitbake
BBPATH .= ":${LAYERDIR}"

# We have a recipes directory containing .bb and .bbappend files, add to BBFILES
BBFILES += "${LAYERDIR}/recipes*/*/*.bb \
            ${LAYERDIR}/recipes*/*/*.bbappend"

BBFILE_COLLECTIONS += "azure-device-update"
BBFILE_PATTERN_azure-device-update := "^${LAYERDIR}/"

# Pri 16 ensures that our recipes are applied over other layers.
# This is applicable where we are using appends files to adjust other recipes.
BBFILE_PRIORITY_azure-device-update = "16"
LAYERDEPENDS_azure-device-update = "swupdate"
LAYERSERIES_COMPAT_azure-device-update  = "zeus"

# Layer-specific configuration variables.
# These values can/will be overriden by environment variables
# if those variables are added to the BB_ENV_EXTRAWHITE environment variable.

# ADU_SOFTWARE_VERSION will be written to a file that is read by the ADU Client.
# This value will be reported through the Device Information PnP interface by the ADU Client
# and is the version of the installed content/image/firmware.
# For the ADU reference image this is set to a new value every build.
ADU_SOFTWARE_VERSION ?= "0.0.0.1"

# HW_REV will be written to a file that is used by swupdate
# to determine hardware compatibility.
HW_REV ?= "1.0"
# MANUFACTURER will be written to file that is read by the ADU Client.
# This value will be reported through the Device Information PnP interface by the ADU Client.
# This value is used as the namespace of the content and for compatibiltiy checks.
MANUFACTURER ?= "Contoso"
# MODEL will also be written to file that is read by the ADU Client.
# This value will be reported through the Device Information PnP interface by the ADU Client.
# This value is used in the name of content and for compatibiltiy checks.
MODEL ?= "ADU Raspberry Pi Example"

# ADUC_PRIVATE_KEY is the build host path to the .pem private key file to use to sign the image.
# ADUC_PRIVATE_KEY_PASSWORD is the build host path to the .pass password file for the private key.

BBFILES += "${@' '.join('${LAYERDIR}/%s/recipes*/*/*.%s' % (layer, ext) \
               for layer in '${BBFILE_COLLECTIONS}'.split() for ext in ['bb', 'bbappend'])}"

# Publish the variables to wic plugins we use for our plugin adufs
WICVARS_append += " \
    MANUFACTURER \
    MODEL \
    "
```

## recipes-support/swupdate/swupdate/defconfig
```kconfig
CONFIG_HAVE_DOT_CONFIG=y

CONFIG_LUA=y
CONFIG_LUAPKG="lua"

CONFIG_HW_COMPATIBILITY=y
CONFIG_HW_COMPATIBILITY_FILE="/etc/adu-hw-compat"

CONFIG_CROSS_COMPILE=""
CONFIG_SYSROOT=""
CONFIG_EXTRA_CFLAGS=""
CONFIG_EXTRA_LDFLAGS=""
CONFIG_EXTRA_LDLIBS=""

CONFIG_UBOOT=y
CONFIG_UBOOT_NEWAPI=y
CONFIG_UBOOT_FWENV="/etc/fw_env.config"
CONFIG_HASH_VERIFY=y
CONFIG_SIGNED_IMAGES=y
CONFIG_SIGALG_RAWRSA=y

CONFIG_GUNZIP=y

CONFIG_LIBCONFIG=y
CONFIG_PARSERROOT=""

CONFIG_RAW=y
CONFIG_ARCHIVE=y
CONFIG_BOOTLOADERHANDLER=y
# CONFIG_MTD is not set 
```

## wic/adu-raspberrypi.wks
```
# Wic Kickstart file that defines which partitions are present in wic images.
# See https://www.yoctoproject.org/docs/current/mega-manual/mega-manual.html#ref-kickstart

# NOTE: Wic will update the /etc/fstab file in the .wic* images,
# but this file needs to also be in sync with the base-files fstab file
# that gets provisioned in the rootfs. Otherwise, updates will install
# an incompatible fstab file.

# Boot partition containing bootloader. This must be the first entry.
part /boot --source bootimg-partition --ondisk mmcblk0 --fstype=vfat --label boot --active --align 4096 --size 20 --fsoptions "defaults,sync"

# Primary rootfs partition. This must be the second entry.
part / --source rootfs --ondisk mmcblk0 --fstype=ext4 --label rootA --align 4096 --extra-space 512

# Secondary rootfs partition used for A/B updating. Starts as a copy of the primary rootfs partition.
# This must be the third entry.
part --source rootfs --ondisk mmcblk0 --fstype=ext4 --label rootB --align 4096 --extra-space 512

# ADU parition for ADU specfic configuration and logs.
# This partition allows configuration and logs to persist across updates (similar to a user data partition).
# The vfat file type allows this partition to be viewed and written to from Linux or Windows.
part /adu --source adufs --ondisk mmcblk0 --fstype=vfat --label adu --align 4096 --size 512 --fsoptions "defaults,gid=800,uid=800"
```
